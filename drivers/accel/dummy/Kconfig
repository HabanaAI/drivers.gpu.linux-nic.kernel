## drivers/accel/dummy/Kconfig
```kconfig
# SPDX-License-Identifier: GPL-2.0-only
#
config ACCEL_DUMMY
	tristate "Drive for a dummy compute accelerator"
	depends on DRM_ACCEL
	help
	  An example of a compute accelerator driver that registers with drm
	  as a compute accelerator.

	  This driver does not actually do anything.

	  If unsure, say N.

	  To compile this driver as a module, choose M here: the
	  module will be called accel_dummy.
```

## drivers/infiniband/hw/hbl/Kconfig
```kconfig
# SPDX-License-Identifier: GPL-2.0-only
#
# HabanaLabs (an Intel Company) Infiniband driver configuration
#

config INFINIBAND_HBL
	tristate "HabanaLabs (an Intel Company) InfiniBand driver"
	depends on NETDEVICES && ETHERNET && PCI && INET
	select HABANA_CN
	help
	  This driver enables InfiniBand functionality for the network
	  interfaces that are part of the GAUDI ASIC family of AI Accelerators.
	  The network interfaces are mainly used for scaling-out the training of
	  AI Neural Networks through ROCEv2 protocol.

	  To compile this driver as a module, choose M here. The module
	  will be called habanalabs_ib.
```
